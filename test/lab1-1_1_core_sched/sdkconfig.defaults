## test/lab1-1_1_core_sched/sdkconfig.defaults
```kconfig
# ESP32 with 4MB flash size
CONFIG_ESPTOOLPY_FLASHSIZE_4MB=y
CONFIG_ESPTOOLPY_FLASHSIZE="4MB"

# disable watchdog for task
CONFIG_ESP_TASK_WDT=n

# run an one core 
CONFIG_FREERTOS_UNICORE=y

# Trace facility to extract trace information
CONFIG_FREERTOS_USE_TRACE_FACILITY=y
CONFIG_FREERTOS_USE_STATS_FORMATTING_FUNCTIONS=y
CONFIG_FREERTOS_VTASKLIST_INCLUDE_COREID=y
```
